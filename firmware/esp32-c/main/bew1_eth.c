// Ethernet init for the Olimex ESP32-POE-ISO.
// Uses on-chip EMAC + LAN8710A PHY over RMII with the 50 MHz reference
// clock sourced from the ESP32's APLL on GPIO17.
// GPIO12 is driven HIGH to enable the PHY's power supply; note this pin
// is an ESP32 strapping pin (MTDI/flash voltage select), so the board has
// an external pull-down to keep it LOW at reset — we only drive it HIGH
// *after* boot, which is safe.

#include "bew1_eth.h"

#include <string.h>

#include "driver/gpio.h"
#include "esp_eth.h"
#include "esp_event.h"
#include "esp_log.h"
#include "esp_netif.h"
#include "freertos/FreeRTOS.h"
#include "freertos/task.h"

static const char *TAG = "bew1-eth";

#define OLIMEX_POE_ISO_PHY_ADDR      0
#define OLIMEX_POE_ISO_PHY_POWER_PIN 12
#define OLIMEX_POE_ISO_MDC           23
#define OLIMEX_POE_ISO_MDIO          18

static esp_eth_handle_t s_eth_handle = NULL;
static esp_netif_t *s_eth_netif = NULL;

esp_err_t bew1_eth_init(esp_netif_t **out_netif) {
    // 1. Power up the PHY before anything else touches the EMAC.
    gpio_config_t pwr = {
        .pin_bit_mask = 1ULL << OLIMEX_POE_ISO_PHY_POWER_PIN,
        .mode = GPIO_MODE_OUTPUT,
        .pull_up_en = GPIO_PULLUP_DISABLE,
        .pull_down_en = GPIO_PULLDOWN_DISABLE,
        .intr_type = GPIO_INTR_DISABLE,
    };
    ESP_ERROR_CHECK(gpio_config(&pwr));
    ESP_ERROR_CHECK(gpio_set_level(OLIMEX_POE_ISO_PHY_POWER_PIN, 1));
    ESP_LOGI(TAG, "PHY power pin GPIO%d driven HIGH", OLIMEX_POE_ISO_PHY_POWER_PIN);
    // LAN8710A needs ~30ms to stabilise after VDD is applied before MDIO
    // transactions reliably succeed. The datasheet says tVPO ≥ 100µs but
    // in practice the earliest IDF/Olimex examples wait 10-30ms here.
    vTaskDelay(pdMS_TO_TICKS(30));

    // 2. Default netif for Ethernet.
    esp_netif_config_t netif_cfg = ESP_NETIF_DEFAULT_ETH();
    s_eth_netif = esp_netif_new(&netif_cfg);
    if (!s_eth_netif) return ESP_FAIL;

    // 3. MAC config (internal EMAC). RMII clock is generated by ESP32
    // (APLL output) and fed to the PHY via GPIO17.
    eth_esp32_emac_config_t emac_cfg = ETH_ESP32_EMAC_DEFAULT_CONFIG();
    emac_cfg.smi_gpio.mdc_num = OLIMEX_POE_ISO_MDC;
    emac_cfg.smi_gpio.mdio_num = OLIMEX_POE_ISO_MDIO;
    emac_cfg.clock_config.rmii.clock_mode = EMAC_CLK_OUT;
    emac_cfg.clock_config.rmii.clock_gpio = 17;  // GPIO17 on POE-ISO

    eth_mac_config_t mac_cfg = ETH_MAC_DEFAULT_CONFIG();
    esp_eth_mac_t *mac = esp_eth_mac_new_esp32(&emac_cfg, &mac_cfg);
    if (!mac) { ESP_LOGE(TAG, "mac_new_esp32 failed"); return ESP_FAIL; }

    // 4. PHY: LAN8710A is register-compatible with the LAN87xx family driver.
    eth_phy_config_t phy_cfg = ETH_PHY_DEFAULT_CONFIG();
    phy_cfg.phy_addr = OLIMEX_POE_ISO_PHY_ADDR;
    phy_cfg.reset_gpio_num = -1;  // no dedicated reset; soft reset is sufficient
    esp_eth_phy_t *phy = esp_eth_phy_new_lan87xx(&phy_cfg);
    if (!phy) { ESP_LOGE(TAG, "phy_new_lan87xx failed"); return ESP_FAIL; }

    esp_eth_config_t eth_cfg = ETH_DEFAULT_CONFIG(mac, phy);
    esp_err_t err = esp_eth_driver_install(&eth_cfg, &s_eth_handle);
    if (err != ESP_OK) { ESP_LOGE(TAG, "eth_driver_install: %s", esp_err_to_name(err)); return err; }

    // 5. Attach the Ethernet driver to the netif so DHCP / LwIP can run.
    esp_eth_netif_glue_handle_t glue = esp_eth_new_netif_glue(s_eth_handle);
    ESP_ERROR_CHECK(esp_netif_attach(s_eth_netif, glue));

    ESP_ERROR_CHECK(esp_eth_start(s_eth_handle));
    *out_netif = s_eth_netif;
    return ESP_OK;
}

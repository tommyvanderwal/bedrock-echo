## firmware/esp32-c/sdkconfig.defaults
```kconfig
# Bedrock Echo witness — ESP-IDF config for Olimex ESP32-POE-ISO.
# Keep the config minimal: Ethernet on, Wi-Fi/BT off, optimise for size.

# ─── Ethernet (on-chip EMAC, Olimex POE-ISO) ────────────────────────────────
# POE-ISO: PHY ref clock is generated by the ESP32 APLL and output on GPIO17.
CONFIG_ETH_USE_ESP32_EMAC=y
CONFIG_ETH_PHY_INTERFACE_RMII=y
CONFIG_ETH_RMII_CLK_OUTPUT=y
CONFIG_ETH_RMII_CLK_OUTPUT_GPIO0=n
CONFIG_ETH_RMII_CLK_OUT_GPIO=17
CONFIG_ETH_USE_SPI_ETHERNET=n

# ─── Wi-Fi / BT off (Olimex POE-ISO is Ethernet-only by design) ─────────────
CONFIG_ESP_WIFI_ENABLED=n
CONFIG_BT_ENABLED=n

# ─── Size-optimised build ───────────────────────────────────────────────────
CONFIG_COMPILER_OPTIMIZATION_SIZE=y
CONFIG_COMPILER_OPTIMIZATION_ASSERTIONS_SILENT=y
CONFIG_ESP_ERR_TO_NAME_LOOKUP=n

# ─── LwIP: IPv4 only for v0.001 ─────────────────────────────────────────────
CONFIG_LWIP_IPV6=n
CONFIG_LWIP_DHCP_DOES_ARP_CHECK=n

# ─── Partition table ────────────────────────────────────────────────────────
CONFIG_PARTITION_TABLE_CUSTOM=y
CONFIG_PARTITION_TABLE_CUSTOM_FILENAME="partitions.csv"

# ─── NVS for the persistent X25519 private key ──────────────────────────────
CONFIG_NVS_ENCRYPTION=n

# ─── Logging ────────────────────────────────────────────────────────────────
CONFIG_LOG_DEFAULT_LEVEL_INFO=y
CONFIG_LOG_COLORS=y

# ─── mbedTLS: we need X25519 + ChaCha20-Poly1305 + HMAC-SHA256 ──────────────
# We use the Everest (HACL*) X25519 scalarmult directly, not via ECDH —
# cleaner API, constant-time by construction.
CONFIG_MBEDTLS_ECP_C=y
CONFIG_MBEDTLS_ECDH_C=y
CONFIG_MBEDTLS_ECP_DP_CURVE25519_ENABLED=y
CONFIG_MBEDTLS_ECDH_LEGACY_CONTEXT=y
CONFIG_MBEDTLS_CHACHA20_C=y
CONFIG_MBEDTLS_POLY1305_C=y
CONFIG_MBEDTLS_CHACHAPOLY_C=y
CONFIG_MBEDTLS_HKDF_C=y
CONFIG_MBEDTLS_SHA256_C=y
```
